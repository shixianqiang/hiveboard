## linux-2.6.32.9_hiveboard/arch/unicore/Kconfig
```kconfig
#
# For a description of the syntax of this configuration file,
# see Documentation/kbuild/kconfig-language.txt.
#

mainmenu "Linux Kernel Configuration"

config UNICORE
	bool
	default y
	select HAVE_OPROFILE
	select HAVE_FUNCTION_TRACER
	select HAVE_GENERIC_DMA_COHERENT
	help
	  The UniCore series is a line of low-power-consumption RISC chip designs
	  licensed by PKUnity Ltd and targeted at embedded applications and
	  handhelds. See web page at <http://www.pkunity.com/>.

config HAVE_PWM
	bool

config GENERIC_GPIO
	bool

#config GENERIC_TIME
#	bool
#	default n

#config GENERIC_CLOCKEVENTS
#	bool
#	default n

config NO_IOPORT
	bool

config GENERIC_HARDIRQS
	bool
	default y

config STACKTRACE_SUPPORT
	bool
	default n

config HAVE_LATENCYTOP_SUPPORT
	bool
	default y

config LOCKDEP_SUPPORT
	bool
	default y

config TRACE_IRQFLAGS_SUPPORT
	bool
	default y

config GENERIC_IRQ_PROBE
	bool
	default y

config RWSEM_GENERIC_SPINLOCK
	bool
	default y

config RWSEM_XCHGADD_ALGORITHM
	bool

config ARCH_HAS_ILOG2_U32
	bool

config ARCH_HAS_ILOG2_U64
	bool

config ARCH_HAS_CPUFREQ
	bool
	help
	  Internal node to signify that the ARCH has CPUFREQ support
	  and that the relevant menu configurations are displayed for
	  it.

config GENERIC_BUG
	bool
	default y
	depends on BUG

config GENERIC_HWEIGHT
	bool
	default y

config GENERIC_CALIBRATE_DELAY
	bool
	default y

config ARCH_MAY_HAVE_PC_FDC
	bool

config ZONE_DMA
	bool

config REALMODE
	bool

config GENERIC_HARDIRQS_NO__DO_IRQ
	def_bool y

config VECTORS_BASE
	hex
	default 0xffff0000 if MMU
	default 0x00000000
	help
	  The base address of exception vectors.

config KUSER_BASE
	hex
	default 0x80000000
	help
	  The base address of kuser area.

source "init/Kconfig"

source "kernel/Kconfig.freezer"

menu "System Type"

config MMU
	bool "MMU-based Paged Memory Management Support"
	default y
	help
	  Select if you want MMU-based virtualised addressing space
	  support by paged memory management. If unsure, say 'Y'.

config ARCH_FPGA
	bool

if ARCH_FPGA

config FPGA_DLX200
	bool
	default ARCH_FPGA

endif

choice
	prompt "PKUnity system type"
	default ARCH_PUV3

	config ARCH_PUV3
	bool "PKUnity v3 (SuperK)"
	select CPU_UCV2
	select PKUNITY_AMBA
	select ZONE_DMA
	select EMBEDDED
	select GENERIC_TIME
	select GENERIC_CLOCKEVENTS
	select HAVE_CLK
	select ARCH_REQUIRE_GPIOLIB
	select ARCH_HAS_CPUFREQ

############# added by zhangyang 2010-05-13 15:32
	config ARCH_SEP0611
    bool "SEP0611"
    select CPU_UCV2
    select PKUNITY_AMBA
    select ZONE_DMA
    select EMBEDDED
    select GENERIC_TIME
    select GENERIC_GPIO
    select ARCH_WANT_OPTIONAL_GPIOLIB
    select GENERIC_CLOCKEVENTS
    select ARCH_HAS_CPUFREQ
  #  select HAVE_CLK
    help
        Support for SEP0611 based boards. here,some select need to be think more.

endchoice

source "arch/unicore/mach-puv3/Kconfig"
########### added by zhangyang 2010-05-13 15:22
source "arch/unicore/mach-sep0611/Kconfig"

config HIGHMEM
	bool "High Memory Support (EXPERIMENTAL)"
	depends on MMU && EXPERIMENTAL
	help
	  The address space of UniCore processors is only 4 Gigabytes large
	  and it has to accommodate user address space, kernel address
	  space as well as some memory mapped IO. That means that, if you
	  have a large amount of physical memory and/or IO, not all of the
	  memory can be "permanently mapped" by the kernel. The physical
	  memory that is not permanently mapped is called "high memory".

	  Depending on the selected kernel/user memory split, minimum
	  vmalloc space and actual amount of RAM, you may not need this
	  option which should result in a slightly faster kernel.

	  If unsure, say n.

config HIGHPTE
	bool "Allocate 2nd-level pagetables from highmem"
	depends on HIGHMEM

source "arch/unicore/mm/Kconfig"

comment "Floating poing support"

config UNICORE_FPU_F64
	bool "UniCore-FPU (F64) support"
	depends on !ARCH_FPGA
	default y

endmenu

menu "Bus support"

config PKUNITY_AMBA
	bool

config PCI
	bool "PCI Support"
	help
	  Find out whether you have a PCI motherboard. PCI is the name of a
	  bus system, i.e. the way the CPU talks to the other stuff inside
	  your box. Other bus systems are ISA, EISA, MicroChannel (MCA) or
	  VESA. If you have PCI, say Y, otherwise N.

config PCI_SYSCALL
	def_bool PCI

source "drivers/pci/Kconfig"

source "drivers/pcmcia/Kconfig"

endmenu

menu "Kernel Features"

source "kernel/time/Kconfig"

config PAGE_OFFSET
	hex
	default 0xC0000000

############### commented by zhangyang 2010-05-13 21:48
#config HOTPLUG_CPU
#	bool "Support for hot-pluggable CPUs (EXPERIMENTAL)"
#	depends on SMP && HOTPLUG && EXPERIMENTAL
#	help
#	  Say Y here to experiment with turning CPUs off and on.  CPUs
#	  can be controlled through /sys/devices/system/cpu.

source "kernel/Kconfig.preempt"

source "kernel/Kconfig.hz"

source "mm/Kconfig"

############### commented by zhangyang 2010-05-13 16:50
#config LEDS
#	bool "CPU heartbeat LEDs"
#	depends on GENERIC_GPIO
#	default n
#	help
#	  If you say Y here, the LEDs on your machine will be used
#	  to provide useful information about your current system status.

config ALIGNMENT_TRAP
	bool
	default y
	help
	  Unicore processors can not fetch/store information which is not
	  naturally aligned on the bus, i.e., a 4 byte fetch must start at an
	  address divisible by 4. On 32-bit Unicore processors, these non-aligned
	  fetch/store instructions will be emulated in software if you say
	  here, which has a severe performance impact. This is necessary for
	  correct operation of some network protocols. With an IP-only
	  configuration it is safe to say N, otherwise say Y.

endmenu

menu "Boot options"

config CMDLINE_FROM_U_BOOT
	bool "Passing CMDLINE from u-boot"
	default y

config CMDLINE
	string "Default kernel command string"
	default ""
	help
	  As a minimum, you should specify the
	  memory size and the root device (e.g., mem=64M root=/dev/nfs).

endmenu

menu "Userspace binary formats"

source "fs/Kconfig.binfmt"

endmenu

menu "Power management options"

source "kernel/power/Kconfig"

if ARCH_HAS_CPUFREQ
source "drivers/cpufreq/Kconfig"
#by zy
config CPU_FREQ_SEP6200
	bool "CPUfreq driver for SEP6200 "
	depends on CPU_FREQ 
	default n
#by zy
endif

config ARCH_SUSPEND_POSSIBLE
	def_bool y if !ARCH_FPGA

config ARCH_HIBERNATION_POSSIBLE
	bool
	default y if !ARCH_FPGA

endmenu

################# commented by zhangyang 2010-05-13 20:32
source "net/Kconfig"
#source "drivers/pkunity/Kconfig"
source "drivers/Kconfig"
source "fs/Kconfig"
source "arch/unicore/Kconfig.debug"
source "security/Kconfig"
source "crypto/Kconfig"
source "lib/Kconfig"
```

## linux-2.6.32.9_hiveboard/arch/unicore/Kconfig.debug
```kconfig
menu "Kernel hacking"

source "lib/Kconfig.debug"

config EARLY_PRINTK
	bool "Early printk"
	default DEBUG_OCD
	help
	  Write kernel log output directly into the ocd or to a serial port.

	  This is useful for kernel debugging when your machine crashes very
	  early before the console code is initialized. For normal operation
	  it is not recommended because it looks ugly and doesn't cooperate
	  with klogd/syslogd or the X server. You should normally N here,
	  unless you want to debug such a crash.

config DEBUG_USER
	bool "Verbose user fault messages"
	help
	  When a user program crashes due to an exception, the kernel can
	  print a brief message explaining what the problem was. This is
	  sometimes helpful for debugging but serves no purpose on a
	  production system. Most people should say N here.

	  In addition, you need to pass user_debug=N on the kernel command
	  line to enable this feature.  N consists of the sum of:

	      1 - undefined instruction events
	      2 - system calls
	      4 - invalid data aborts
	      8 - SIGSEGV faults
	     16 - SIGBUS faults

config DEBUG_STACK_USAGE
	bool "Enable stack utilization instrumentation"
	depends on DEBUG_KERNEL
	help
	  Enables the display of the minimum amount of free stack which each
	  task has ever had available in the sysrq-T output.

# These options are only for real kernel hackers who want to get their hands dirty.
config DEBUG_LL
	bool "Kernel low-level debugging functions"
	depends on DEBUG_KERNEL
	help
	  Say Y here to include definitions of printascii, printch, printhex
	  in the kernel.  This is helpful if you are debugging code that
	  executes before the console is initialized.

config DEBUG_OCD
	bool "Kernel low-level debugging via On-Chip-Debugger"
	depends on DEBUG_LL
	default y
	help
	  Say Y here if you want the debug print routines to direct their
	  output to the UniCore On-Chip-Debugger channel using CP #1.

config DEBUG_OCD_BREAKPOINT
	bool "Breakpoint support via On-Chip-Debugger"
	depends on DEBUG_OCD

config DEBUG_UART
	int "Kernel low-level debugging messages via serial port"
	depends on DEBUG_LL
	range 0 1
	default "0"
	help
	  Choice for UART for kernel low-level using PKUnity UARTS,
	  should be between zero and one. The port must have been
	  initialised by the boot-loader before use.

config SYSCALL_TRACE
	bool "Enable system calls trace"
	depends on DEBUG_LL
	help
	  This allows the trace of the entry and exit of system calls.

config VECTORS_TRACE
	bool "Enable vectors trace"
	depends on DEBUG_LL
	help
	  This allows the trace of the entry and exit of some exceptions.

config VECTORS_TRACE_INTR
	bool "Enable INTR mode vectors trace"
	depends on VECTORS_TRACE
	default	n
	help
	  This allows the trace of the entry and exit of INTR exceptions.

config VECTORS_TRACE_ABRT
	bool "Enable ABRT mode vectors trace"
	depends on VECTORS_TRACE
	default	n
	help
	  This Enables the trace of the entry and exit of ABRT exceptions.

config VECTORS_TRACE_EXTN
	bool "Enable EXTN mode vectors trace"
	depends on VECTORS_TRACE
	default	n
	help
	  This enables the trace of the entry and exit of EXTN exceptions.

endmenu
```

## linux-2.6.32.9_hiveboard/arch/unicore/mach-puv3/Kconfig
```kconfig
#
if ARCH_PUV3

choice
	prompt "Board Selection"
	default PUV3_DB0913

config PUV3_FPGA_DLX200
	select ARCH_FPGA
	select FPGA_DLX200
	bool "FPGA board (DLX200)"

config PUV3_DB0913
	bool "DEBUG board (0913)"

config PUV3_NB0916
	bool "NetBook board (0916)"
	select HAVE_PWM

config PUV3_SMW0919
	bool "Security Mini-Workstation board (0919)"

endchoice

config PUV3_PM
	bool
	depends on !ARCH_FPGA
	default y

endif
```

## linux-2.6.32.9_hiveboard/arch/unicore/mach-sep0611/Kconfig
```kconfig
config MACH_SEP0611
	bool
	default y

choice
	prompt "Select The Target Board"
	depends on ARCH_SEP0611
	default HIVEBOARD

config TIGER_TEST_BOARD
	bool "Tiger Test Board"
	help
	  Say Y or N if you want to add support tiger test board	  

config TIGER_DEMO_BOARD
	bool "Tiger Demo Board"
	help
	  Say Y or N if you want to add support tiger demo board

config TIGER_SPDW_BOARD
	bool "Tiger Spreadwin Board"
	help
	  Say Y or N if you want to add support tiger spreadwin board

config HIVEBOARD
        bool "Hiveboard"
        help
          Say Y or N if you want to add support Hiveboard


endchoice

config SEP_CLK_800
   bool "SEP clock use 804/201/402MHz"
   depends on CPU_FREQ_DEFAULT_GOV_PERFORMANCE 
   help
     Support board, Say Y here if you
     want to use 804/201/402Mhz (you have to change the core voltage and use DDR2 RAM)

config SEP_CLK_600
   bool "SEP clock use 600/201/402MHz"
   depends on CPU_FREQ_DEFAULT_GOV_PERFORMANCE && !SEP_CLK_800 
   help
     Support board, Say Y here if you
     want to use 600/201/402Mhz (you have to change the core voltage and use DDR2 RAM)

config SEP_CLK_500
   bool "SEP clock use 504/201/402MHz"
   depends on CPU_FREQ_DEFAULT_GOV_PERFORMANCE && !SEP_CLK_800  && !SEP_CLK_600
   help
     Support board, Say Y here if you
     want to use 504/201/402Mhz (you have to change the core voltage and use DDR2 RAM)
```

## linux-2.6.32.9_hiveboard/drivers/video/sep0611/Kconfig
```kconfig
config FB_SEP0611_NUM
	int "Number of framebuffer's layers"
	depends on FB_SEP0611 
	default "1"
	help
	  SEP0611 LCD controller supports at most four layers.
	  You can set the number between 1 and 4, and the default
	  number is 1.

choice
	prompt "SEP0611 LCD TYPE"
	depends on FB_SEP0611
	default FB_SEP0611_LCD_AT070TN93

config FB_SEP0611_LCD_AT070TN93
	bool "AT070TN93 LCD support(800*480)"
	
config FB_SEP0611_LCD_AT070TN90
	bool "AT070TN90 LCD support(800*480)"
	
config FB_SEP0611_LCD_HSD050
	bool "HSD050GT09 LCD support(800*480)"
	
endchoice

menuconfig FB_SEP0611_LAYERS_MODE
	bool "BPP for framebuffer layers"
	depends on FB_SEP0611
	default y

choice FB_SEP0611_LAYER0
	bool "framebuffer layer0's BPP"
	depends on FB_SEP0611_LAYERS_MODE
	default FB_SEP0611_LAYER0_BPP16

config FB_SEP0611_LAYER0_BPP16
	bool "16 bpp"
	depends on FB_SEP0611 

config FB_SEP0611_LAYER0_BPP32
	bool "32 bpp"
	depends on FB_SEP0611 
endchoice

choice FB_SEP0611_LAYER1
	bool "framebuffer layer1's BPP or YUV"
	depends on FB_SEP0611_LAYERS_MODE
	default FB_SEP0611_LAYER1_BPP16

config FB_SEP0611_LAYER1_BPP16
	bool "16 bpp"
	depends on FB_SEP0611 

config FB_SEP0611_LAYER1_BPP32
	bool "32 bpp"
	depends on FB_SEP0611

config FB_SEP0611_LAYER1_YUV444 
	bool "yuv444"
	depends on FB_SEP0611

config FB_SEP0611_LAYER1_YUV422
	bool "yuv422"
	depends on FB_SEP0611

config FB_SEP0611_LAYER1_YUV420
	bool "yuv420"
	depends on FB_SEP0611

config FB_SEP0611_LAYER1_YUV420_SEMI
	bool "yuv420-semi"
	depends on FB_SEP0611
endchoice

choice FB_SEP0611_LAYER2
	bool "framebuffer layer2's BPP"
	depends on FB_SEP0611_LAYERS_MODE
	default FB_SEP0611_LAYER2_BPP16

config FB_SEP0611_LAYER2_BPP16
	bool "16 bpp"
	depends on FB_SEP0611 

config FB_SEP0611_LAYER2_BPP32
	bool "24 bpp unpacked"
	depends on FB_SEP0611 
endchoice

choice FB_SEP0611_LAYER3
	bool "framebuffer layer3' BPP"
	depends on FB_SEP0611_LAYERS_MODE
	default FB_SEP0611_LAYER3_BPP2

config FB_SEP0611_LAYER3_BPP1_A
	bool "1 bpp include transparent"
	depends on FB_SEP0611

config FB_SEP0611_LAYER3_BPP1_B
	bool "1 bpp"
	depends on FB_SEP0611

config FB_SEP0611_LAYER3_BPP2_A
	bool "2 bpp include transparent"
	depends on FB_SEP0611

config FB_SEP0611_LAYER3_BPP2_B
	bool "2 bpp"
	depends on FB_SEP0611
endchoice

config FB_SEP0611_DOUBLE_BUFFER
	bool "sep0611fb double buffer support"
	depends on FB_SEP0611

config SEP0611_OVERLAY
	tristate "sep0611 overlay support"
	depends on FB_SEP0611
	default y

config SEP0611_BACKLIGHT
	tristate "Backlight Driver for sep0611"
	depends on LEDS_CLASS && FB_SEP0611
	default y
	help
	  Say Y to enable the backlight driver on sep0611 based boards.
```

## linux-2.6.32.9_hiveboard/sound/soc/sep0611/Kconfig
```kconfig
config SND_SEP0611_SOC
	tristate "ASoC for the SEP0611"
	depends on ARCH_SEP0611
	default y
	help
	  Say Y or M if you want to add support for codecs attached to
	  the SEP0611 I2S interface. You will also need
	  to select the audio interfaces to support below.
	  
choice
	prompt "SEP0611 Codec Select"
	depends on SND_SEP0611_SOC
	default CODEC_WM8976

config CODEC_WM8976
	bool "WM8976"
	help
	  Say Y or M if you want to add support for codec WM8976 on SEP0611
	
config CODEC_CS3700
	bool "CS3700"
	help
	  Say Y or M if you want to add support for codec CS3700 on SEP0611


endchoice
```
